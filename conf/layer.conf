## conf/layer.conf
```bitbake
# We have a conf and classes directory, add to BBPATH
BBPATH .= ":${LAYERDIR}"

# We have recipes-* directories, add to BBFILES
BBFILES += "${LAYERDIR}/recipes-*/*/*.bb \
            ${LAYERDIR}/recipes-*/*/*.bbappend"

BBFILES_DYNAMIC += " \
    qt5-layer:${LAYERDIR}/dynamic-layers/qt5-layer/*/*.bb \
    qt5-layer:${LAYERDIR}/dynamic-layers/qt5-layer/*/*.bbappend \
    qt6-layer:${LAYERDIR}/dynamic-layers/qt6-layer/*/*.bb \
    qt6-layer:${LAYERDIR}/dynamic-layers/qt6-layer/*/*.bbappend \
"

BBFILE_COLLECTIONS += "meta-renesas"
BBFILE_PATTERN_meta-renesas = "^${LAYERDIR}/"
BBFILE_PRIORITY_meta-renesas = "6"

LAYERDEPENDS_meta-renesas = "core openembedded-layer meta-python"
LAYERSERIES_COMPAT_meta-renesas = "styhead"
```
