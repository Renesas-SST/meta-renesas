## meta-rz-common/wic/rzg2l-sbc-image-bootpart-mmc0.wks
```
# short-description: Create SD card image with a boot partition
# long-description: Creates a partitioned SD card image. Some of boot files
# are located in the first vfat partition but not mounted. The second ext4 partition
# will contain all boot files and boot environment file.

part --source bootimg-partition --ondisk mmcblk0 --fstype=vfat --label boot --active --align 16 --fixed-size 100
part / --source rootfs --ondisk mmcblk0 --fstype=ext4 --label root --align 16 --overhead-factor 1.0
```

## meta-rzg2l/conf/machine/rzpi.conf
```bitbake
#@TYPE: Machine
#@NAME: RZ SBC machine
#@DESCRIPTION: RZ/G2L SBC platform

SOC_FAMILY = "r9a07g044l"
require conf/machine/include/rzg2l-common.inc
require conf/machine/include/cip-core.inc

DEFAULTTUNE ?= "cortexa55"

TUNE_CONF ?= "conf/machine/include/tune-cortexa55.inc"
require ${TUNE_CONF}

PREFERRED_PROVIDER_virtual/kernel="linux-renesas"

UBOOT_CONFIG ??= "rzpi"
UBOOT_CONFIG[rzpi] = "rzpi_defconfig"

# flash writer
EXTRA_IMAGEDEPENDS += " flash-writer"

# Support board with PMIC. Default:yes.
# With this option enabled, build both bin files for PMIC board and Concrete board.
PMIC_SUPPORT ?= "1"

# Supported device tree and device tree overlays
KERNEL_DEVICETREE = " \
	renesas/rzpi.dtb \
"
KERNEL_DEVICETREE_OVERLAY = " \
	renesas/overlays/rzpi-can.dtbo \
	renesas/overlays/rzpi-ext-i2c.dtbo \
	renesas/overlays/rzpi-ext-spi.dtbo \
	renesas/overlays/rzpi-dsi.dtbo \
	renesas/overlays/rzpi-ov5640.dtbo \
"

IMAGE_BOOT_FILES = " Image rzpi.dtb"

# Support DTB Overlay files
IMAGE_BOOT_FILES += " overlays/*;overlays/"
```
